## CMakeLists.txt
```
# SPDX-License-Identifier: Apache-2.0

cmake_minimum_required(VERSION 3.20.0)
find_package(Zephyr REQUIRED HINTS $ENV{ZEPHYR_BASE})
project(espnow_sample)

target_sources(app PRIVATE src/main.c)
```

## Kconfig
```
# SPDX-License-Identifier: Apache-2.0

mainmenu "ESP-NOW Sample"

menu "ESP-NOW Configuration"

choice ESPNOW_ROLE
	prompt "Device role"
	default ESPNOW_ROLE_BIDIR
	help
	  SENDER:   transmits heartbeat beacons only.
	  RECEIVER: listens only (no beacon thread).
	  BIDIR:    transmits beacons AND receives — loopback test with two devices.

config ESPNOW_ROLE_SENDER
	bool "Sender"

config ESPNOW_ROLE_RECEIVER
	bool "Receiver"

config ESPNOW_ROLE_BIDIR
	bool "Bidir (send + receive)"

endchoice

config ESPNOW_CHANNEL
	int "WiFi channel"
	range 1 13
	default 1
	help
	  Both devices must use the same channel.

config ESPNOW_BEACON_INTERVAL_S
	int "Beacon interval (seconds)"
	range 1 60
	default 5
	depends on ESPNOW_ROLE_SENDER || ESPNOW_ROLE_BIDIR

endmenu

source "Kconfig.zephyr"
```

## sample.yaml
```
sample:
  description: ESP-NOW broadcast heartbeat beacon sample for Espressif ESP32 boards
  name: ESP-NOW
tests:
  sample.boards.espressif.espnow:
    build_only: true
    platform_allow:
      - esp32s3_devkitc/esp32s3/procpu
      - esp32c6_devkitc/esp32c6/hpcore
    tags: esp32 espnow wifi
```

## prj.conf
```kconfig
CONFIG_MULTITHREADING=y
CONFIG_MAIN_STACK_SIZE=8192

CONFIG_LOG=y
CONFIG_LOG_MODE_DEFERRED=y
CONFIG_LOG_DEFAULT_LEVEL=3
CONFIG_THREAD_NAME=y

CONFIG_SERIAL=y
CONFIG_CONSOLE=y
CONFIG_UART_CONSOLE=y
CONFIG_PRINTK=y

# ESP-NOW uses the ESP-IDF WiFi blobs directly and never touches the Zephyr
# network stack. However, CONFIG_WIFI Kconfig-selects NET_L2_WIFI_MGMT
# which in turn selects NETWORKING, and NETWORKING requires NET_IPV4=y to
# satisfy its dependency chain. This is a known limitation of the current
# Kconfig structure for Espressif WiFi drivers — the IP stack symbols are
# required by the build system even though ESP-NOW bypasses them entirely.
CONFIG_WIFI=y
CONFIG_NETWORKING=y
CONFIG_NET_L2_ETHERNET=y
CONFIG_NET_IPV4=y

# Minimise net_buf pool sizes to reclaim RAM — ESP-NOW never enqueues
# packets through the Zephyr net stack.
CONFIG_NET_PKT_RX_COUNT=4
CONFIG_NET_PKT_TX_COUNT=4
CONFIG_NET_BUF_RX_COUNT=8
CONFIG_NET_BUF_TX_COUNT=8
```

## src/main.c
```c
/*
 * Copyright (c) 2026 Rapyuta Robotics
 * SPDX-License-Identifier: Apache-2.0
 *
 * ESP-NOW sample — broadcast heartbeat beacons and/or receive them.
 *
 * Role is selected at build time via Kconfig:
 *   CONFIG_ESPNOW_ROLE_SENDER   — TX only
 *   CONFIG_ESPNOW_ROLE_RECEIVER — RX only
 *   CONFIG_ESPNOW_ROLE_BIDIR     — TX + RX (default; loopback test with two boards)
 *
 * Both devices must be on the same WiFi channel (CONFIG_ESPNOW_CHANNEL).
 * No AP is required — the channel is fixed via esp_wifi_set_channel().
 */

#include <zephyr/kernel.h>
#include <zephyr/logging/log.h>
#include <inttypes.h>
#include <string.h>

#include <esp_now.h>
#include <esp_wifi.h>

LOG_MODULE_REGISTER(espnow_sample, LOG_LEVEL_INF);

/*
 * Heartbeat frame — fixed-layout, 14 bytes on the wire.
 * seq and uptime_ms use little-endian (native ESP32).
 */
struct __packed espnow_heartbeat {
	uint32_t seq;
	uint32_t uptime_ms;
	uint8_t src_mac[ESP_NOW_ETH_ALEN];
};

static const uint8_t k_bcast_mac[ESP_NOW_ETH_ALEN] = {0xFF, 0xFF, 0xFF, 0xFF, 0xFF, 0xFF};

/*
 * RX callback — WiFi task context; no blocking, no heap alloc.
 */
#if defined(CONFIG_ESPNOW_ROLE_RECEIVER) || defined(CONFIG_ESPNOW_ROLE_BIDIR)
static void recv_cb(const esp_now_recv_info_t *info, const uint8_t *data, int len)
{
	const uint8_t *mac = info->src_addr;
	const uint8_t *dst = info->des_addr;
	int8_t rssi = info->rx_ctrl->rssi;
	bool bcast = (dst[0] == 0xFF);

	LOG_INF("RX [%s] from %02x:%02x:%02x:%02x:%02x:%02x  rssi=%d  len=%d",
		bcast ? "BCAST" : "UNICAST", mac[0], mac[1], mac[2], mac[3], mac[4], mac[5], rssi,
		len);

	if (len == (int)sizeof(struct espnow_heartbeat)) {
		const struct espnow_heartbeat *hb = (const struct espnow_heartbeat *)data;

		LOG_INF("  heartbeat seq=%" PRIu32 "  uptime=%" PRIu32 " ms"
			"  src=%02x:%02x:%02x:%02x:%02x:%02x",
			hb->seq, hb->uptime_ms, hb->src_mac[0], hb->src_mac[1], hb->src_mac[2],
			hb->src_mac[3], hb->src_mac[4], hb->src_mac[5]);
	} else {
		LOG_HEXDUMP_INF(data, MIN(len, 32), "  payload:");
	}
}
#endif /* RECEIVER || BOTH */

/*
 * TX callback — WiFi task context.
 */
#if defined(CONFIG_ESPNOW_ROLE_SENDER) || defined(CONFIG_ESPNOW_ROLE_BIDIR)
static void send_cb(const esp_now_send_info_t *info, esp_now_send_status_t status)
{
	const uint8_t *mac = info->des_addr;

	if (status == ESP_NOW_SEND_SUCCESS) {
		LOG_INF("TX OK  → %02x:%02x:%02x:%02x:%02x:%02x", mac[0], mac[1], mac[2], mac[3],
			mac[4], mac[5]);
	} else {
		LOG_ERR("TX FAIL → %02x:%02x:%02x:%02x:%02x:%02x", mac[0], mac[1], mac[2], mac[3],
			mac[4], mac[5]);
	}
}

/*
 * Beacon thread — sends a heartbeat broadcast every BEACON_INTERVAL_S.
 */
#define BEACON_STACK_SIZE 2048
#define BEACON_PRIORITY   5

static void beacon_thread(void *p1, void *p2, void *p3)
{
	ARG_UNUSED(p1);
	ARG_UNUSED(p2);
	ARG_UNUSED(p3);
	k_thread_name_set(k_current_get(), "beacon");

	uint32_t seq = 0;

	while (true) {
		struct espnow_heartbeat hb = {};

		hb.seq = seq++;
		hb.uptime_ms = k_uptime_get_32();
		esp_wifi_get_mac(WIFI_IF_STA, hb.src_mac);

		LOG_INF("TX beacon seq=%" PRIu32 "  uptime=%" PRIu32 " ms"
			"  mac=%02x:%02x:%02x:%02x:%02x:%02x",
			hb.seq, hb.uptime_ms, hb.src_mac[0], hb.src_mac[1], hb.src_mac[2],
			hb.src_mac[3], hb.src_mac[4], hb.src_mac[5]);

		esp_now_send(k_bcast_mac, (const uint8_t *)&hb, sizeof(hb));

		k_sleep(K_SECONDS(CONFIG_ESPNOW_BEACON_INTERVAL_S));
	}
}

K_THREAD_STACK_DEFINE(s_beacon_stack, BEACON_STACK_SIZE);
static struct k_thread s_beacon_tid;
#endif /* SENDER || BOTH */

/*
 * main
 */
int main(void)
{
	esp_now_peer_info_t peer = {};
	esp_err_t rc;

	/* 1. WiFi STA mode + start — driver already called esp_wifi_init(),
	 *    so we only need to set the mode, start the stack, and fix the
	 *    channel.  No AP is required for ESP-NOW.
	 */
	esp_wifi_set_storage(WIFI_STORAGE_RAM);
	esp_wifi_set_mode(ESP32_WIFI_MODE_STA);
	rc = esp_wifi_start();
	if (rc != ESP_OK) {
		LOG_ERR("esp_wifi_start failed: 0x%x", rc);
		return -EIO;
	}

	/* 2. Lock to configured channel — no AP needed */
	esp_wifi_set_channel(CONFIG_ESPNOW_CHANNEL, WIFI_SECOND_CHAN_NONE);

	/* 3. ESP-NOW init + callbacks */
	rc = esp_now_init();
	if (rc != ESP_OK) {
		LOG_ERR("esp_now_init failed: 0x%x", rc);
		return -EIO;
	}

#if defined(CONFIG_ESPNOW_ROLE_RECEIVER) || defined(CONFIG_ESPNOW_ROLE_BIDIR)
	esp_now_register_recv_cb(recv_cb);
#endif
#if defined(CONFIG_ESPNOW_ROLE_SENDER) || defined(CONFIG_ESPNOW_ROLE_BIDIR)
	esp_now_register_send_cb(send_cb);
#endif

	/* 4. Add broadcast peer (required before esp_now_send to FF:FF:FF:FF:FF:FF) */
	memcpy(peer.peer_addr, k_bcast_mac, ESP_NOW_ETH_ALEN);
	peer.channel = CONFIG_ESPNOW_CHANNEL;
	peer.ifidx = WIFI_IF_STA;
	peer.encrypt = false;
	esp_now_add_peer(&peer);

	uint32_t ver = 0;

	esp_now_get_version(&ver);
	LOG_INF("ESP-NOW v%u ready  ch=%u  role=%s", (unsigned int)ver, CONFIG_ESPNOW_CHANNEL,
#if defined(CONFIG_ESPNOW_ROLE_SENDER)
		"SENDER"
#elif defined(CONFIG_ESPNOW_ROLE_RECEIVER)
		"RECEIVER"
#else
		"BIDIR"
#endif
	);

	/* 5. Start beacon thread (sender / both roles) */
#if defined(CONFIG_ESPNOW_ROLE_SENDER) || defined(CONFIG_ESPNOW_ROLE_BIDIR)
	k_thread_create(&s_beacon_tid, s_beacon_stack, K_THREAD_STACK_SIZEOF(s_beacon_stack),
			beacon_thread, NULL, NULL, NULL, BEACON_PRIORITY, 0, K_NO_WAIT);
	LOG_INF("Beacon thread started  interval=%ds", CONFIG_ESPNOW_BEACON_INTERVAL_S);
#else
	LOG_INF("Receiver-only mode — waiting for beacons");
#endif

	return 0;
}
```
